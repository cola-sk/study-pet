## apps/pet-device/main/Kconfig.projbuild
```kconfig
menu "Study Pet network"
config STUDY_PET_WIFI_SSID
    string "2.4 GHz Wi-Fi SSID"
    default ""
    help
        Optional development fallback. Settings on the device can scan and save
        Wi-Fi credentials in NVS; those take precedence over this fallback.
        Keep sdkconfig and firmware private when using a compiled fallback.
config STUDY_PET_WIFI_PASSWORD
    string "Wi-Fi password"
    default ""
config STUDY_PET_DEVICE_TOKEN
    string "Device API token (64 lowercase hex characters)"
    default ""
    help
        Device-specific credential. Keep sdkconfig and firmware private.
endmenu
```
